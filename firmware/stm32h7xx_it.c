

//MIT License
//
//Copyright (c) 2019 tvelliott
//
//Permission is hereby granted, free of charge, to any person obtaining a copy
//of this software and associated documentation files (the "Software"), to deal
//in the Software without restriction, including without limitation the rights
//to use, copy, modify, merge, publish, distribute, sublicense, and/or sell
//copies of the Software, and to permit persons to whom the Software is
//furnished to do so, subject to the following conditions:
//
//The above copyright notice and this permission notice shall be included in all
//copies or substantial portions of the Software.
//
//THE SOFTWARE IS PROVIDED "AS IS", WITHOUT WARRANTY OF ANY KIND, EXPRESS OR
//IMPLIED, INCLUDING BUT NOT LIMITED TO THE WARRANTIES OF MERCHANTABILITY,
//FITNESS FOR A PARTICULAR PURPOSE AND NONINFRINGEMENT. IN NO EVENT SHALL THE
//AUTHORS OR COPYRIGHT HOLDERS BE LIABLE FOR ANY CLAIM, DAMAGES OR OTHER
//LIABILITY, WHETHER IN AN ACTION OF CONTRACT, TORT OR OTHERWISE, ARISING FROM,
//OUT OF OR IN CONNECTION WITH THE SOFTWARE OR THE USE OR OTHER DEALINGS IN THE
//SOFTWARE.




#include "stm32h7xx_hal.h"
#include "stm32h7xx.h"
#include "main.h"
#include "stm32h7xx_it.h"
#include "globals.h"
#include <string.h>

volatile int do_i2s;
extern SPI_HandleTypeDef hspi3;
extern DMA_HandleTypeDef hdma_adc1;
extern DMA_HandleTypeDef hdma_spi2_tx;
extern I2S_HandleTypeDef hi2s2;
extern DMA_HandleTypeDef hdma_adc3;
extern ADC_HandleTypeDef hadc3;
extern TIM_HandleTypeDef htim2;
extern TIM_HandleTypeDef htim3;
extern int do_gqrx;
extern volatile int ir_timeout;
extern volatile int ir_found_start;
extern volatile int ir_nbits;
extern volatile uint32_t ir_code;

//////////////////////////////////////////////////////////////////////////////////////////
//////////////////////////////////////////////////////////////////////////////////////////
void NMI_Handler( void )
{
}

//////////////////////////////////////////////////////////////////////////////////////////
//////////////////////////////////////////////////////////////////////////////////////////
void MemManage_Handler( void )
{
  while( 1 ) {
  }
}

//////////////////////////////////////////////////////////////////////////////////////////
//////////////////////////////////////////////////////////////////////////////////////////
void BusFault_Handler( void )
{
  while( 1 ) {
  }
}

//////////////////////////////////////////////////////////////////////////////////////////
//////////////////////////////////////////////////////////////////////////////////////////
void UsageFault_Handler( void )
{
  while( 1 ) {
  }
}

//////////////////////////////////////////////////////////////////////////////////////////
//////////////////////////////////////////////////////////////////////////////////////////
void SVC_Handler( void )
{
}

//////////////////////////////////////////////////////////////////////////////////////////
//////////////////////////////////////////////////////////////////////////////////////////
void DebugMon_Handler( void )
{
}

//////////////////////////////////////////////////////////////////////////////////////////
//////////////////////////////////////////////////////////////////////////////////////////
void PendSV_Handler( void )
{
}

//////////////////////////////////////////////////////////////////////////////////////////
//////////////////////////////////////////////////////////////////////////////////////////
void SysTick_Handler( void )
{
  HAL_IncTick();
  HAL_SYSTICK_IRQHandler();
}

//////////////////////////////////////////////////////////////////////////////////////////
//  not used, but interrupt version of spi transfer is only function that works in HAL
//////////////////////////////////////////////////////////////////////////////////////////
void SPI3_IRQHandler( void )
{
  HAL_SPI_IRQHandler( &hspi3 );
}

//////////////////////////////////////////////////////////////////////////////////////////
//////////////////////////////////////////////////////////////////////////////////////////
void ADC_IRQHandler( void )
{
  HAL_ADC_IRQHandler( &hadc1 );
  HAL_ADC_IRQHandler( &hadc2 );
}

//////////////////////////////////////////////////////////////////////////////////////////
//////////////////////////////////////////////////////////////////////////////////////////
void HAL_ADC_ErrorCallback( ADC_HandleTypeDef *hadc )
{
  __HAL_ADC_CLEAR_FLAG( hadc, ADC_FLAG_OVR );
}
//////////////////////////////////////////////////////////////////////////////////////////
//////////////////////////////////////////////////////////////////////////////////////////
void DMA1_Stream0_IRQHandler( void )
{
  HAL_DMA_IRQHandler( &hdma_adc1 );
}
//////////////////////////////////////////////////////////////////////////////////////////
//////////////////////////////////////////////////////////////////////////////////////////
void SPI2_IRQHandler( void )
{
  HAL_I2S_IRQHandler( &hi2s2 );
}
//////////////////////////////////////////////////////////////////////////////////////////
//////////////////////////////////////////////////////////////////////////////////////////
void DMA1_Stream1_IRQHandler( void )
{
  HAL_DMA_IRQHandler( &hdma_spi2_tx );
}
//////////////////////////////////////////////////////////////////////////////////////////
//////////////////////////////////////////////////////////////////////////////////////////
void DMA2_Stream0_IRQHandler( void )
{
  HAL_DMA_IRQHandler( &hdma_adc3 );
}

//////////////////////////////////////////////////////////////////////////////////////////
//////////////////////////////////////////////////////////////////////////////////////////
void ADC3_IRQHandler( void )
{
  HAL_ADC_IRQHandler( &hadc3 );
}
//////////////////////////////////////////////////////////////////////////////////////////
//////////////////////////////////////////////////////////////////////////////////////////
void EXTI3_IRQHandler( void )
{
  int timerval;
  timerval = ( int ) __HAL_TIM_GetCounter( &htim2 );
  __HAL_TIM_SetCounter( &htim2, 0x0000 ); //clear timer

  ir_remote_rx( timerval );
  HAL_GPIO_EXTI_IRQHandler( GPIO_PIN_3 );
}
//////////////////////////////////////////////////////////////////////////////////////////
//////////////////////////////////////////////////////////////////////////////////////////
void TIM3_IRQHandler( void )
{
  //int timerval;
  //timerval = (int) __HAL_TIM_GetCounter(&htim3);
  //__HAL_TIM_SetCounter(&htim3, 32768);  //clear timer
  //printf("\r\ntim3: int");

  if( ir_timeout > 0 ) {
#if 0
    if( HAL_GPIO_ReadPin( IR_INPUT_GPIO_Port, IR_INPUT_Pin ) ) printf( "1 " );
    else printf( "0 " );
#else
    if( ir_nbits++ < 43 ) {
      ir_code <<= 1;
      if( HAL_GPIO_ReadPin( IR_INPUT_GPIO_Port, IR_INPUT_Pin ) ) ir_code |= 0x01;
    }
#endif
  }

  HAL_TIM_IRQHandler( &htim3 );
}
